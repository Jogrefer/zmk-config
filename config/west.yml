## config/west.yml
```yaml
manifest:
  remotes:
    - name: zmkfirmware
      url-base: https://github.com/zmkfirmware
    - name: jogrefer
      url-base: https://github.com/jogrefer
  projects:
    - name: zmk
      remote: zmkfirmware
      revision: main
      import: app/west.yml
    - name: zmk-keyboard-jogrefer
      remote: jogrefer
      revision: main
  self:
    path: config
```
